## west.yml
```yaml
# The west manifest file for rt1170 NXP VEE

manifest:
  remotes:
    - name: nxp-mcuxpresso
      url-base: https://github.com/nxp-mcuxpresso
    - name: freertos
      url-base: https://github.com/FreeRTOS
    - name: NXP
      url-base: https://github.com/NXP
  # Please add items below in reverse alphabetical order
  projects:
    - name: mcux-sdk
      remote: nxp-mcuxpresso
      revision: MCUX_2.15.100
      path: nxpvee-mimxrt1170-evk/bsp/mcux-sdk/core
    - name: FreeRTOS-Kernel
      revision: MCUX_2.15.100
      remote: nxp-mcuxpresso
      path: nxpvee-mimxrt1170-evk/bsp/mcux-sdk/rtos/freertos/freertos-kernel
    - name: CMSIS_5
      path: nxpvee-mimxrt1170-evk/bsp/mcux-sdk/core/CMSIS
      revision: MCUX_2.15.000
      remote: nxp-mcuxpresso
    - name: fatfs
      remote: nxp-mcuxpresso
      path: nxpvee-mimxrt1170-evk/bsp/mcux-sdk/middleware/fatfs
      revision: MCUX_2.15.100
    - name: mcux-sdk-middleware-sdmmc
      remote: nxp-mcuxpresso
      revision: MCUX_2.15.100
      path: nxpvee-mimxrt1170-evk/bsp/mcux-sdk/middleware/sdmmc
    - name: lwip
      remote: nxp-mcuxpresso
      revision: MCUX_2.15.100
      path: nxpvee-mimxrt1170-evk/bsp/mcux-sdk/middleware/lwip
    - name: mbedtls
      remote: nxp-mcuxpresso
      revision: MCUX_2.15.100
      path: nxpvee-mimxrt1170-evk/bsp/mcux-sdk/middleware/mbedtls
    - name: coreHTTP
      remote: freertos
      revision: v3.1.0
      path: nxpvee-mimxrt1170-evk/bsp/mcux-sdk/middleware/coreHTTP
    - name: wifi_nxp
      remote: NXP
      revision: MCUX_2.15.100
      path: nxpvee-mimxrt1170-evk/bsp/mcux-sdk/middleware/wifi_nxp
    - name: mcux-sdk-middleware-tensorflow
      remote: nxp-mcuxpresso
      revision: MCUX_2.15.100
      path: nxpvee-mimxrt1170-evk/bsp/mcux-sdk/middleware/eiq/tensorflow-lite
    - name: mcux-sdk-middleware-eiq
      remote: nxp-mcuxpresso
      revision: MCUX_2.15.100
      path: nxpvee-mimxrt1170-evk/bsp/mcux-sdk/middleware/eiq

  self:
    path: nxpvee-mimxrt1170-evk
```
